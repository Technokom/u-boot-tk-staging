## board/technokom/common/Kconfig
```kconfig
config TI_COMMON_CMD_OPTIONS
	bool "Enable cmd options on TI platforms"
	imply CMD_ASKENV
	imply CMD_BOOTZ
	imply CRC32_VERIFY if ARCH_KEYSTONE
	imply CMD_DFU if USB_GADGET_DOWNLOAD
	imply CMD_DHCP
	imply CMD_EEPROM
	imply CMD_EXT2
	imply CMD_EXT4
	imply CMD_EXT4_WRITE
	imply CMD_FASTBOOT if FASTBOOT
	imply CMD_FAT
	imply FAT_WRITE if CMD_FAT
	imply CMD_FS_GENERIC
	imply CMD_GPIO
	imply CMD_GPT
	imply CMD_I2C
	imply CMD_MII
	imply CMD_MMC
	imply CMD_PART
	imply CMD_PING
	imply CMD_PMIC if DM_PMIC
	imply CMD_REGULATOR if DM_REGULATOR
	imply CMD_SF if SPI_FLASH
	imply CMD_SPI
	imply CMD_TIME
	imply CMD_USB if USB
```

## board/technokom/tk-som-am43xx/Kconfig
```kconfig
if TARGET_TK_SOM_AM43XX

config SYS_BOARD
	default "tk-som-am43xx"

config SYS_VENDOR
	default "technokom"

config SYS_SOC
	default "am33xx"

config SYS_CONFIG_NAME
	default "tk-som-am43xx"

source "board/technokom/common/Kconfig"

endif
```

## configs/tk-som-am43xx_defconfig
```kconfig
CONFIG_ARM=y
CONFIG_ARCH_OMAP2PLUS=y
CONFIG_TI_COMMON_CMD_OPTIONS=y
CONFIG_SYS_MALLOC_F_LEN=0x2000
CONFIG_AM43XX=y
CONFIG_TARGET_TK_SOM_AM43XX=y
CONFIG_DEFAULT_DEVICE_TREE="tk-som-am43xx"
CONFIG_SPL_LOAD_FIT=y
# CONFIG_SPL_NAND_SUPPORT is not set
CONFIG_SYS_EXTRA_OPTIONS="CONS_INDEX=1"
CONFIG_SYS_CONSOLE_INFO_QUIET=y
CONFIG_SYS_MMCSD_RAW_MODE_U_BOOT_SECTOR=0x600
CONFIG_VERSION_VARIABLE=y
CONFIG_SPL=y
# CONFIG_SPL_ETH_SUPPORT is not set
CONFIG_SPL_OS_BOOT=y
CONFIG_HUSH_PARSER=y
# CONFIG_DM_I2C_COMPAT
CONFIG_DM_I2C=y
CONFIG_CMD_SPL=y
CONFIG_CMD_ASKENV=y
CONFIG_CMD_SPL_WRITE_SIZE=0x40000
CONFIG_CMD_FLASH is not set
CONFIG_CMD_SETEXPR is not set
CONFIG_ISO_PARTITION=y
CONFIG_OF_CONTROL=y
CONFIG_OF_LIST="tk-som-am43xx"
CONFIG_DM=y
CONFIG_SPL_LIBCOMMON_SUPPORT=y
# CONFIG_BLK is not set
CONFIG_DFU_MMC=y
CONFIG_DFU_RAM=y
CONFIG_DFU_SF=y
CONFIG_DM_GPIO=y
CONFIG_DM_MMC=y
CONFIG_MMC_OMAP_HS=y
CONFIG_SPI_FLASH=y
CONFIG_SPI_FLASH_MACRONIX=y
CONFIG_PHYLIB=y
CONFIG_DM_ETH=y
CONFIG_NETDEVICES=y
CONFIG_PHY_GIGE=y
CONFIG_DM_SERIAL=y
CONFIG_SYS_NS16550=y
CONFIG_TIMER=y
CONFIG_OMAP_TIMER=y
CONFIG_CMD_TK_SERIAL=y
CONFIG_USB=y
CONFIG_USB_XHCI_HCD=y
CONFIG_USB_XHCI_DWC3=y
CONFIG_USB_DWC3=y
CONFIG_USB_DWC3_GADGET=y
CONFIG_USB_DWC3_OMAP=y
CONFIG_USB_DWC3_PHY_OMAP=y
CONFIG_USB_STORAGE=y
CONFIG_USB_GADGET=y
CONFIG_G_DNL_MANUFACTURER="TechnoKom Limited"
CONFIG_G_DNL_VENDOR_NUM=0x27B6
CONFIG_G_DNL_PRODUCT_NUM=0x0111
CONFIG_USB_GADGET_DOWNLOAD=y
# CONFIG_USB_ETHER is not set
```
